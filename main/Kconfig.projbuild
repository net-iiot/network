## main/Kconfig.projbuild
```kconfig
menu "Wetzel Mesh (Configurações)"

choice WM_DEVICE_ROLE
    prompt "Device Role"
    default WM_ROLE_GATEWAY
    help
      Selecione o papel do firmware que você está compilando.

config WM_ROLE_GATEWAY
    bool "Gateway"
    help
      Compila/roda como GATEWAY:
      - BLE e ESPNOW desativados;
      - Apenas UART com o nó-borda e caminho ao servidor.
      - Modo de produção - comunica com servidor via HTTP.

config WM_ROLE_NODE
    bool "Node"
    help
      Compila/roda como NODE:
      - Mesh ESPNOW ativa;
      - BLE sempre ativo (todos os nodes têm BLE);
      - UART detectado automaticamente: se houver gateway conectado via UART, 
        o node se comunica com ele automaticamente.
      IMPORTANTE: Todos os nodes são iguais. A diferença é apenas se há ou não 
      um gateway conectado via UART. Isso é detectado automaticamente.
endchoice

config WETZEL_IS_GATEWAY
    bool
    default y if WM_ROLE_GATEWAY
    default n if WM_ROLE_NODE

menu "Isolamento de Rede"
    help
      Configure o isolamento de redes mesh. Nodes só se conectam a outros nodes
      com o mesmo Network ID, canal WiFi e chave de criptografia.
      IMPORTANTE: Todos os nodes da mesma rede física devem ter o mesmo Network ID e Canal.

config WETZEL_NETWORK_ID
    string "Network ID (identificador da rede)"
    default "rede-01"
    help
      Identificador único da rede mesh. Nodes só se conectam a outros nodes
      com o mesmo Network ID. A chave de criptografia ESP-NOW é derivada
      deste ID, garantindo isolamento total entre redes.
      Exemplo: "rede-01", "rede-02", "rede-03"

config WETZEL_WIFI_CHANNEL
    int "Canal WiFi para ESP-NOW (1-13)"
    default 1
    range 1 13
    help
      Canal WiFi usado para comunicação ESP-NOW.
      Recomendado: 1, 6 ou 11 (não se sobrepõem).
      Para múltiplas redes, use canais diferentes:
      - Rede 1: canal 1
      - Rede 2: canal 6
      - Rede 3: canal 11

config WETZEL_NEIGHBOR_TIMEOUT_MS
    int "Timeout de Neighbors (milissegundos)"
    default 12000
    range 4000 60000
    help
      Tempo em milissegundos sem receber HELLO antes de considerar um node como desconectado.
      HELLO é enviado a cada 2 segundos, então este valor deve ser múltiplo de 2000ms.
      Recomendado: 12000ms (12 segundos) - permite perder até 5 HELLOs consecutivos.
      Valores menores detectam desconexões mais rápido, mas podem ser sensíveis a perdas temporárias de pacotes.

endmenu


menu "Credenciais de Rede (apenas Gateway)"
    depends on WM_ROLE_GATEWAY
    help
      Configure as credenciais de rede para o Gateway (WiFi e servidor).
      Estas configurações são usadas apenas quando o firmware roda como Gateway.

config WETZEL_GATEWAY_WIFI_SSID
    string "SSID da Rede WiFi"
    default "COR_ELE"
    help
      Nome da rede WiFi que o gateway irá conectar.
      Configure o nome exato da sua rede WiFi aqui.
      Exemplo: "MinhaRedeWiFi"

config WETZEL_GATEWAY_WIFI_PASSWORD
    string "Senha da Rede WiFi"
    default "Cwe@1602"
    help
      Senha da rede WiFi. Deixe vazio para rede aberta.
      Configure a senha da sua rede WiFi aqui.

config WETZEL_GATEWAY_SERVER_URL
    string "URL do Servidor HTTP"
    default "http://172.16.10.110:5003"
    help
      URL completa do servidor HTTP onde o microserviço está rodando.
      Exemplo: http://192.168.1.100:8080
      O gateway enviará todos os dados recebidos da mesh para este servidor.

endmenu

endmenu
```

## sdkconfig.defaults
```kconfig
CONFIG_BLINK_LED_GPIO=y
CONFIG_BLINK_GPIO=8
CONFIG_BT_BLE_ENABLED=y
CONFIG_ESP_MAIN_TASK_STACK_SIZE=7168
CONFIG_ESP_WIFI_IRAM_OPT=n
CONFIG_ESP_WIFI_RX_IRAM_OPT=n
CONFIG_BT_ENABLED=y
CONFIG_BT_NIMBLE_ENABLED=n
CONFIG_BT_BLUEDROID_ENABLED=y
CONFIG_BT_CLASSIC_ENABLED=y
CONFIG_COMPILER_OPTIMIZATION_SIZE=y
CONFIG_LOG_DEFAULT_LEVEL_WARN=y
CONFIG_FREERTOS_PLACE_FUNCTIONS_INTO_IRAM=n
CONFIG_FREERTOS_PLACE_SNAPSHOT_FUNCS_INTO_IRAM=n
```
